## boards/shields/optokbd/Kconfig.defconfig
```kconfig
if SHIELD_OPTOKBD_LEFT

config ZMK_KEYBOARD_NAME
    default "optokbd"

config ZMK_SPLIT_ROLE_CENTRAL
    default y

endif # SHIELD_OPTOKBD_LEFT

if SHIELD_OPTOKBD_LEFT || SHIELD_OPTOKBD_RIGHT

config ZMK_SPLIT
    default y

endif # SHIELD_OPTOKBD_LEFT || SHIELD_OPTOKBD_RIGHT
```

## boards/shields/optokbd/Kconfig.shield
```kconfig
config SHIELD_OPTOKBD_LEFT
    def_bool $(shields_list_contains,optokbd_left)

config SHIELD_OPTOKBD_RIGHT
    def_bool $(shields_list_contains,optokbd_right)
```

## boards/shields/single_key/Kconfig.defconfig
```kconfig
if SHIELD_SINGLE_KEY

config ZMK_KEYBOARD_NAME
    default "Single Key"

endif # SHIELD_SINGLE_KEY
```
